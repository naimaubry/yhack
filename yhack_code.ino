#include <Wire.h>
#include <Adafruit_GFX.h>
#include <Adafruit_SSD1306.h>
#include <Servo.h>
#include <Arduino.h>
#include <AccelStepper.h>

// state machine
enum Scene {
  WELCOME,
  SOY_LEVEL,
  SESAME_LEVEL,
  START_CONFIRM,
  MAKING_TOFU
};

// process steps
enum ProcessStep {
  STEP_COMPRESS_HALF,
  STEP_WAIT_20_MIN,
  STEP_CUT_DOWN,
  STEP_RETRACT_UP,
  STEP_DISPENSE_SOY,
  STEP_DISPENSE_SESAME,
  STEP_PUSH_SYRINGE,
  STEP_DONE
};

Scene currentScene = WELCOME;
ProcessStep currentStep = STEP_COMPRESS_HALF;
unsigned long stepStartTime = 0;

// OLED SETUP
#define SCREEN_WIDTH 128  // OLED width, in pixels
#define SCREEN_HEIGHT 64  // OLED height, in pixels
Adafruit_SSD1306 display(SCREEN_WIDTH, SCREEN_HEIGHT, &Wire, -1);

// PINS
// buttons
const int LEFT_BUTTON = 2;
const int RIGHT_BUTTON = 3;
const int ENTER_BUTTON = 4;

// potentiometer
#define POT_PIN A0

// STEPPER PINS 

//lead screw stepper
#define LS_STEP_PIN 6
#define LS_DIR_PIN 7
AccelStepper leadScrew(AccelStepper::DRIVER, LS_STEP_PIN, LS_DIR_PIN);

//valve stepper
#define valve_STEP_PIN 8
#define valve_DIR_PIN 9
AccelStepper valveStepper(AccelStepper::DRIVER, valve_STEP_PIN, valve_DIR_PIN);

// SERVOS
Servo soyServo;
Servo sesameServo;

const int soyServoPin = 10;
const int sesameServoPin = 11;

const int eject1 = 12;
const int eject2 = 13;

// user selections
int soyLevel = 0;      
int sesameLevel = 0;  
const int maxAmount = 5;

// step parameters

const long LEADSCREW_PRESS_STEPS = 1200;
const long LEADSCREW_CUT_STEPS = 2200; 
const int SOY_SERVO_CLOSED = 0;
const int SOY_SERVO_OPEN = 90;
const int SESAME_SERVO_CLOSED = 0;
const int SESAME_SERVO_OPEN = 90;
const int VALVE_PUSH_STEPS = 400;
const int VALVE_RETRACT_STEPS = -400;

// BITMAPS
// 'SillyTofu', 128x64px
const unsigned char epd_bitmap_SillyTofu[] PROGMEM = {
  0xff, 0xff, 0xff, 0xff, 0xff, 0xff, 0xff, 0xff, 0xff, 0xff, 0xff, 0xff, 0xff, 0xff, 0xff, 0xff,
  0xff, 0xff, 0xff, 0xff, 0xff, 0xff, 0xff, 0xff, 0xff, 0xff, 0xff, 0xff, 0xff, 0xff, 0xff, 0xff,
  0xff, 0xff, 0xff, 0xff, 0xff, 0xff, 0xff, 0xff, 0xff, 0xff, 0xff, 0xff, 0xff, 0xff, 0xff, 0xff,
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  0xff, 0xff, 0xff, 0xff, 0xff, 0xff, 0xff, 0xff, 0xff, 0xff, 0xff, 0xff, 0xff, 0xff, 0xff, 0xff
};
// 'SauceTofu', 128x64px
const unsigned char epd_bitmap_SauceTofu[] PROGMEM = {
  0xff, 0xff, 0xf8, 0x00, 0x7f, 0xc3, 0xfe, 0x7f, 0xe7, 0xe0, 0x03, 0xf0, 0x00, 0xff, 0xff, 0xff,
  0xff, 0xff, 0xf0, 0x00, 0xff, 0x81, 0xfe, 0x7f, 0xe7, 0xc0, 0x01, 0xe0, 0x00, 0x7f, 0xff, 0xff,
  0xff, 0xff, 0xe1, 0xff, 0xff, 0x00, 0xfe, 0x7f, 0xe7, 0x8f, 0xff, 0xe3, 0xff, 0xff, 0xff, 0xff,
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  0xff, 0xff, 0xff, 0xff, 0xff, 0xff, 0xff, 0xff, 0xff, 0xff, 0xff, 0xff, 0xff, 0xff, 0xff, 0xff
};
// 'WelcomeTofu', 128x64px
const unsigned char epd_bitmap_WelcomeTofu[] PROGMEM = {
  0xff, 0xff, 0xf9, 0xff, 0x9e, 0x00, 0x07, 0x9f, 0xff, 0xe7, 0xff, 0xff, 0x00, 0xff, 0xff, 0xff,
  0xff, 0xff, 0xf9, 0xff, 0x9e, 0x00, 0x07, 0x9f, 0xff, 0xe7, 0xff, 0xfe, 0x3c, 0x7f, 0xff, 0xff,
  0xff, 0xff, 0xf9, 0xff, 0x9e, 0x7f, 0xff, 0x9f, 0xff, 0xe7, 0xff, 0xfc, 0x7e, 0x3f, 0xff, 0xff,
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  0xff, 0xff, 0xff, 0xff, 0xff, 0xc0, 0x00, 0x00, 0x03, 0xff, 0xff, 0xff, 0xff, 0xff, 0xff, 0xff
};
// 'FinishedTofu', 128x64px
const unsigned char epd_bitmap_FinishedTofu[] PROGMEM = {
  0xff, 0xff, 0xe3, 0xfc, 0x79, 0xff, 0x3f, 0x8f, 0x1f, 0xf8, 0xf1, 0xfc, 0x7f, 0x8f, 0xff, 0xff,
  0xff, 0xff, 0xe1, 0xf8, 0x79, 0xff, 0x3f, 0x86, 0x1f, 0xf8, 0x61, 0xfc, 0x3f, 0x0f, 0xff, 0xff,
  0xff, 0xff, 0xf0, 0xf0, 0xf9, 0xff, 0x3f, 0x26, 0x4f, 0xf2, 0x64, 0xfe, 0x1e, 0x1f, 0xff, 0xff,
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  0xff, 0xff, 0xff, 0xff, 0xff, 0xc0, 0x00, 0x00, 0x03, 0xff, 0xff, 0xff, 0xff, 0xff, 0xff, 0xff
};


// SerLCD Setup
void setupSerLCD() {
  Serial1.begin(9600);
  delay(100);
  clearSerLCD();
}

void clearSerLCD() {
  Serial1.write(0xFE);
  Serial1.write(0x01);  // Clear display
  delay(10);
}

void printSerLCD(const String &line1, const String &line2 = "") {
  clearSerLCD();
  Serial1.print(line1);
  if (line2.length() > 0) {
    Serial1.write(0xFE);
    Serial1.write(0xC0);  // Move to second line
    Serial1.print(line2);
  }
}

bool leftPressed() {
  return digitalRead(LEFT_BUTTON) == LOW;
}
bool rightPressed() {
  return digitalRead(RIGHT_BUTTON) == LOW;
}
bool enterPressed() {
  return digitalRead(ENTER_BUTTON) == LOW;
}

// potentiometer
int readPotPercent() {
  return map(analogRead(POT_PIN), 0, 1023, 0, 100);  // 0-100%
}


void displaySceneBitmap(Scene scene) {
  display.clearDisplay();
  switch (scene) {
    case WELCOME:
      display.drawBitmap(0, 0, epd_bitmap_WelcomeTofu, 128, 64, WHITE);
      break;
    case SOY_LEVEL:
      display.drawBitmap(0, 0, epd_bitmap_SauceTofu, 128, 64, WHITE);
      break;
    case SESAME_LEVEL:
      display.drawBitmap(0, 0, epd_bitmap_SauceTofu, 128, 64, WHITE);
      break;
    case START_CONFIRM:
      display.drawBitmap(0, 0, epd_bitmap_SillyTofu, 128, 64, WHITE);
      break;
    case MAKING_TOFU:
      display.drawBitmap(0, 0, epd_bitmap_FinishedTofu, 128, 64, WHITE);
      break;
  }
  display.display();
}

void setupMotorsAndServos() {
    // Lead screw stepper
    leadScrew.setMaxSpeed(500);
    leadScrew.setAcceleration(100);

    // Valve stepper
    valveStepper.setMaxSpeed(300);
    valveStepper.setAcceleration(50);

    // Servos
    soyServo.attach(soyServoPin);
    sesameServo.attach(sesameServoPin);
    // syringeServo.attach(syringeServoPin);

    // Eject pins
    pinMode(eject1, OUTPUT);
    pinMode(eject2, OUTPUT);
}


// MOVEMENT FUNCTIONS

// move lead screw to position
void moveLeadScrew(long position) {
  leadScrew.moveTo(position);
  while (leadScrew.distanceToGo() != 0) {
    leadScrew.run();
  }
}

// move valve stepper by amount
void moveValve(int steps) {
  valveStepper.move(steps); // relative move
  while (valveStepper.distanceToGo() != 0) {
    valveStepper.run();
  }
}

// move soy servo to level 0-180
void moveSoyServo(int angle) {
  soyServo.write(angle);
  delay(300); // small delay for motion
}

// move sesame servo to level 0-180
void moveSesameServo(int angle) {
  sesameServo.write(angle);
  delay(300);
}

// // push syringe
// void pushSyringe(int angle) {
//   syringeServo.write(angle);
//   delay(500); // longer delay for full push
// }

// EJECT FUNCTIONS
void activateEject1(unsigned long durationMs = 500) {
  digitalWrite(eject1, HIGH);
  delay(durationMs);
  digitalWrite(eject1, LOW);
}

void activateEject2(unsigned long durationMs = 500) {
  digitalWrite(eject2, HIGH);
  delay(durationMs);
  digitalWrite(eject2, LOW);
}

void activateBothEjectors(unsigned long durationMs = 500) {
  digitalWrite(eject1, HIGH);
  digitalWrite(eject2, HIGH);
  delay(durationMs);
  digitalWrite(eject1, LOW);
  digitalWrite(eject2, LOW);
}

// SETUP

void setup() {

  Serial.begin(9600);

  // Initialize OLED
  if(!display.begin(SSD1306_SWITCHCAPVCC, 0x3C)) {
    Serial.println(F("SSD1306 allocation failed"));
    for(;;);
  }
  display.clearDisplay();
  display.display();

  // Buttons as input with pullups
  pinMode(LEFT_BUTTON, INPUT_PULLUP);
  pinMode(RIGHT_BUTTON, INPUT_PULLUP);
  pinMode(ENTER_BUTTON, INPUT_PULLUP);

  setupMotorsAndServos();

  // pinMode(LED_PIN, OUTPUT);

  // SerLCD
  Serial.print("Start of LCD");
  setupSerLCD();
  printSerLCD("WELCOME", "Click ENTER");
  displaySceneBitmap(currentScene);
}

void loop() {
  // // test buttons
  //   Serial.print("LEFT: ");
  //   Serial.print(digitalRead(2));

  //   Serial.print("RIGHT: ");
  //   Serial.print(digitalRead(3));

  //   Serial.print("ENTER: ");
  //   Serial.println(digitalRead(4));

  //   delay(200);

  // // test potentiometer pin
  // int potValue = analogRead(POT_PIN);       // read analog value
  // int potPercent = map(potValue, 0, 1023, 0, 100); // percentage

  // Serial.print("Pot raw: ");
  // Serial.print(potValue);
  // Serial.print("  Percent: ");
  // Serial.println(potPercent);

  // delay(200);  // small delay to make the output readable

  pickSauce();

  if (currentScene == MAKING_TOFU){
    automateProcess();
  }
}

void pickSauce() {
  static bool yesSelected = true;
  switch (currentScene) {
    case WELCOME:
      if (enterPressed()) {
        delay(200);
        currentScene = SOY_LEVEL;
        displaySceneBitmap(currentScene);
        printSerLCD("Soy level?", String(soyLevel) + "%");
      }
      break;

    // =======================
    case SOY_LEVEL:

      // Update potentiometer
      static int lastSoy = -1;
      soyLevel = readPotPercent();
      if (soyLevel != lastSoy) {
        Serial.print("Soy level updated: ");
        Serial.println(soyLevel);
        printSerLCD("Soy level?", String(soyLevel) + "%");
        lastSoy = soyLevel;
      }

      if (leftPressed()) {
        Serial.println("LEFT pressed");
        soyLevel = max(0, soyLevel - 1);
        delay(150);
      }

      if (rightPressed()) {
        Serial.println("RIGHT pressed");
        soyLevel = min(100, soyLevel + 1);
        delay(150);
      }

      if (enterPressed()) {
        Serial.println("ENTER pressed");
        delay(200);
        currentScene = SESAME_LEVEL;
        displaySceneBitmap(currentScene);
        printSerLCD("Sesame oil?", String(sesameLevel) + "%");
      }
      break;

    // =======================
    case SESAME_LEVEL:

      // Update potentiometer
      static int lastSesame = -1;
      sesameLevel = readPotPercent();
      if (sesameLevel != lastSesame) {
        Serial.print("Sesame level updated: ");
        Serial.println(sesameLevel);
        printSerLCD("Sesame level?", String(sesameLevel) + "%");
        lastSesame = sesameLevel;
      }

      if (leftPressed()) {
        Serial.println("LEFT pressed");
        sesameLevel = max(0, sesameLevel - 1);
        delay(150);
      }

      if (rightPressed()) {
        Serial.println("RIGHT pressed");
        sesameLevel = min(100, sesameLevel + 1);
        delay(150);
      }

      if (enterPressed()) {
        Serial.println("ENTER pressed");
        delay(200);
        currentScene = START_CONFIRM;
        displaySceneBitmap(currentScene);
        printSerLCD("Start?", "YES / NO");
      }
      break;

    // =======================
    case START_CONFIRM:
      if (leftPressed() || rightPressed()) {
        yesSelected = !yesSelected;
        printSerLCD("Start?", yesSelected ? "YES" : "NO");
        delay(200);
      }

      if (enterPressed()) {
        delay(200);
        if (yesSelected) {
          currentScene = MAKING_TOFU;
          displaySceneBitmap(currentScene);
          printSerLCD("Making Tofu...", "");
        } else {
          currentScene = WELCOME;
          displaySceneBitmap(currentScene);
          printSerLCD("WELCOME", "\nClick ENTER");
        }
      }
      break;

    // =======================
    case MAKING_TOFU:

      break;
  }
}

void automateProcess() {
  switch (currentStep) {
    case STEP_COMPRESS_HALF:
      printSerLCD("Compressing halfway...");

      // move actuator halfway code
      moveLeadScrew(LEADSCREW_PRESS_STEPS);
      stepStartTime = millis();
      currentStep = STEP_WAIT_20_MIN;
      break;

    case STEP_WAIT_20_MIN:
      printSerLCD("Waiting 20 min");
      if (millis() - stepStartTime > 20UL * 60UL * 1000UL) {
        currentStep = STEP_CUT_DOWN;
      }
      break;

    case STEP_CUT_DOWN:
      printSerLCD("Cutting");

      // insert code to move actuator full down
      moveLeadScrew(LEADSCREW_CUT_STEPS);
      delay(1000);

      currentStep = STEP_RETRACT_UP;
      break;

    case STEP_RETRACT_UP:
      printSerLCD("Retracting..");

      // insert code to move actuator up
      moveLeadScrew(0);
      delay(1000);

      currentStep = STEP_DISPENSE_SOY;
      break;

    case STEP_DISPENSE_SOY:
      printSerLCD("Soy", String(soyLevel) + "%");

      moveSoyServo(SOY_SERVO_OPEN);
      delay(map(soyLevel, 0, 100, 0, 1500));
      moveSoyServo(SOY_SERVO_CLOSED);
      currentStep = STEP_DISPENSE_SESAME;
      break;

    case STEP_DISPENSE_SESAME:
      printSerLCD("Sesame", String(sesameLevel) + "%");

      // open sesame valve
      moveSesameServo(SESAME_SERVO_OPEN);
      delay(map(sesameLevel, 0, 100, 0, 1500));
      // close sesame valve
      moveSesameServo(SESAME_SERVO_CLOSED);
      currentStep = STEP_PUSH_SYRINGE;
      break;

    case STEP_PUSH_SYRINGE:
      printSerLCD("Injecting sauce");

      // push syringe servo
      moveValve(VALVE_PUSH_STEPS);
      delay(500);
      moveValve(VALVE_RETRACT_STEPS);

      currentStep = STEP_DONE;
      break;

    case STEP_DONE:
      printSerLCD("Done!", "Enjoy");

      // servo to push tofu out of box
      activateBothEjectors();

      delay(3000);

      currentScene = WELCOME;
      currentStep = STEP_COMPRESS_HALF;
      break;
  }
}

